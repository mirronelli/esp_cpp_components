## mDht11/Kconfig.projbuild
```kconfig
# put here your custom config value
menu "DHT11"
config DHT_GPIO_PIN
    string "GPIO Pin"
    help
	Data ping DTH11 is connected to.
endmenu
```

## mWifiClient/Kconfig.projbuild
```kconfig
# put here your custom config value
menu "mWifi"
config MWIFI_SSID
    string "Wifi SSID"
    help
		SSID of network to connect to.

config MWIFI_PASSWORD
    string "Wifi Password"
    help
		Password for network.

endmenu
```
